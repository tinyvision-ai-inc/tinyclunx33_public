## Firmware/zephyr_imx219_dual/Kconfig
```kconfig
# Copyright (c) 2024-2025 tinyVision.ai Inc.
# SPDX-License-Identifier: Apache-2.0

source "$(srctree)/Kconfig.zephyr"
```

## zephyr/Kconfig
```kconfig
# Copyright (c) 2024 tinyVision.ai Inc.
# SPDX-License-Identifier: Apache-2.0

rsource "drivers/Kconfig"
rsource "subsys/Kconfig"
```

## zephyr/boards/tinyvision/tinyclunx33/board.yml
```yaml
board:
  name: tinyclunx33
  vendor: tinyvision
  revision:
    format: custom
    default: "rev2"
    revisions:
      - name: "rev1"
      - name: "rev2"
  socs:
  - name: custom
  - name: rtl_0_8
  - name: rtl_0_9
  - name: rtl_0_10
  - name: rtl_0_11
  - name: rtl_1_0
  - name: rtl_1_1
```

## zephyr/drivers/clock_control/Kconfig
```kconfig
# Copyright (c) 2024 tinyVision.ai Inc.
# SPDX-License-Identifier: Apache-2.0

if CLOCK_CONTROL

rsource "Kconfig.si5351"

endif
```

## zephyr/drivers/clock_control/Kconfig.si5351
```kconfig
config CLOCK_CONTROL_SI5351
  bool "SkyWorks Si5351 PLL"
  default y
  depends on DT_HAS_SKYWORKS_SI5351_ENABLED
  select I2C
  help
    Enable SkyWorks Si5351 PLL
```

## zephyr/drivers/i2c/Kconfig
```kconfig
# Copyright (c) 2024 tinyVision.ai Inc.
# SPDX-License-Identifier: Apache-2.0

if I2C

rsource "Kconfig.pca9542a"
rsource "Kconfig.opencores"

endif
```

## zephyr/drivers/i2c/Kconfig.opencores
```kconfig
config I2C_OPENCORES
	bool "Opencores I2C driver"
	default y
	depends on DT_HAS_OPENCORES_I2C_ENABLED
	help
	  Enable support for Litex I2C driver
```

## zephyr/drivers/i2c/Kconfig.pca9542a
```kconfig
menuconfig I2C_PCA9542A
	bool "NXP PCA9542A 2-channel multiplexer"
	default y
	depends on DT_HAS_NXP_PCA9542A_ENABLED
	help
	  Enable NXP PCA9542A 2-channel multiplexer

if I2C_PCA9542A

config I2C_PCA9542A_ROOT_INIT_PRIO
	int "PCA9542A root driver init priority"
	default I2C_INIT_PRIORITY
	help
	  Should be lower than `I2C_PCA9542A_CHANNEL_INIT_PRIO`

config I2C_PCA9542A_CHANNEL_INIT_PRIO
	int "PCA9542A channel driver init priority"
	default I2C_INIT_PRIORITY
	help
	  Should be higher than I2C_PCA9542A_ROOT_INIT_PRIO

config I2C_PCA9542A_IGNORE_FAILURE
	bool "send the I2C messages when the channel selection fails"
	default n
	help
	  This permits to let I2C message reach their target in case something
	  goes wrong with the I2C multiplexer, or replaced by plain wires.
	  This is disabled by default as I2C messages to the wrong target could
	  have undesired effects.

endif
```

## zephyr/drivers/usb/udc/Kconfig
```kconfig
# Copyright (c) 2024 tinyVision.ai Inc.
# SPDX-License-Identifier: Apache-2.0

if UDC_DRIVER

rsource "Kconfig.dwc3"

endif # UDC_DRIVER
```

## zephyr/drivers/video/Kconfig
```kconfig
# Copyright (c) 2024 tinyVision.ai Inc.
# SPDX-License-Identifier: Apache-2.0

if VIDEO

config VIDEO_I2C_RETRY_NUM
	int "Number of attempts for retrying I2C communication if it failed"
	default 3
	help
	  The default is there to reduce the chance of failure (i.e. occasional EMI) without
	  flooding the I2C bus upon error with too many retries. There is a 1ms wait time between
	  every retry.

rsource "Kconfig.imx219"
rsource "Kconfig.lscc_csi2rx"
rsource "Kconfig.tvai_debayer"
rsource "Kconfig.tvai_stacker"
rsource "Kconfig.tvai_stats"
rsource "Kconfig.tvai_testpattern"
rsource "Kconfig.tvai_unpacker"
rsource "Kconfig.tvai_uvcmanager"

endif
```

## zephyr/drivers/video/Kconfig.lscc_csi2rx
```kconfig
# Copyright (c) 2025 tinyVision.ai Inc.
# SPDX-License-Identifier: Apache-2.0

config VIDEO_LATTICE_CSI2RX
	bool "Driver for Lattice MIPI CSI-2 D-PHY Receiver Submodule"
	depends on DT_HAS_LATTICE_CSI2RX_ENABLED
	default y
	help
	  Enable the driver for the Lattice MIPI-CSI FPGA core.
```

## zephyr/drivers/video/Kconfig.tvai_stacker
```kconfig
# Copyright (c) 2025 tinyVision.ai Inc.
# SPDX-License-Identifier: Apache-2.0

config VIDEO_TINYVISION_STACKER
	bool "stacker present on tinyVision.ai designs"
	depends on DT_HAS_TINYVISION_STACKER_ENABLED
	default y
	help
	  Enable driver for the tinyVision.ai stacker block.
	  This driver does not do any hardware I/O on its own and only describes the
	  properties of the FPGA peripheral that performs the actual video operation.
```

## zephyr/drivers/video/Kconfig.tvai_stats
```kconfig
# Copyright (c) 2025 tinyVision.ai Inc.
# SPDX-License-Identifier: Apache-2.0

config VIDEO_TINYVISION_STATS
	bool "statistic collection engine present on tinyVision.ai designs"
	depends on DT_HAS_TINYVISION_STATS_ENABLED
	default y
	help
	  Enable driver for the tinyVision.ai statistics collection peripheral.
	  This driver does not do any hardware I/O and only provide debug commands and
	  statistics using the upcoming Zephyr stats API.
```

## zephyr/drivers/video/Kconfig.tvai_testpattern
```kconfig
# Copyright (c) 2024 tinyVision.ai Inc.
# SPDX-License-Identifier: Apache-2.0

config VIDEO_TINYVISION_TESTPATTERN
	bool "test pattern generator present on tinyVision.ai designs"
	depends on DT_HAS_TINYVISION_TESTPATTERN_ENABLED
	default y
	help
	  Enable driver for the tinyVision.ai test pattern.
	  This driver does not do any hardware I/O and only describes the
	  properties of the peripheral.
```

## zephyr/drivers/video/Kconfig.tvai_unpacker
```kconfig
# Copyright (c) 2025 tinyVision.ai Inc.
# SPDX-License-Identifier: Apache-2.0

config VIDEO_TINYVISION_UNPACKER
	bool "MIPI to 16-bit pixel unpacker present on tinyVision.ai designs"
	depends on DT_HAS_TINYVISION_UNPACKER_ENABLED
	default y
	help
	  Enable driver for the tinyVision.ai unpacker block.
	  This driver does not do any hardware I/O on its own and only describes the
	  properties of the FPGA peripheral that performs the actual video operation.
```

## zephyr/drivers/video/Kconfig.tvai_uvcmanager
```kconfig
# Copyright (c) 2024 tinyVision.ai Inc.
# SPDX-License-Identifier: Apache-2.0

config VIDEO_TINYVISION_UVCMANAGER
	bool "UVCManager driver for connecting a video source directly to UVC"
	depends on DT_HAS_TINYVISION_UVCMANAGER_ENABLED
	default y
	help
	  Enable the driver for the UVCManager for high bandwidth video to USB3
	  transfers. This file is distributed in binary form.
```

## zephyr/dts/bindings/clock/skyworks,si5351.yaml
```yaml
# Copyright (c) 2024, tinyVision.ai Inc.
# SPDX-License-Identifier: Apache-2.0

description: |
  Skyworks Si5351 programmable PLL

compatible: "skyworks,si5351"

include: [clock-controller.yaml, i2c-device.yaml]

properties:
  "#clock-cells":
    const: 0
```

## zephyr/dts/bindings/i2c/nxp,pca9542a.yaml
```yaml
description: NXP PCA9542A 2-channel multiplexer

compatible: "nxp,pca9542a"

include: i2c-device.yaml

child-binding:
  compatible: "nxp,pca9542a-channel"
  include: i2c-controller.yaml
```

## zephyr/dts/bindings/riscv/tinyvision,soc-controller.yaml
```yaml
# Copyright (c) 2024 tinyVision.ai Inc.
# SPDX-License-Identifier: Apache-2.0

description: |
  Registers that control the general state of the SoC, such as reset

  It is derived from the LiteX definition, but is implemented under
  a different SoC directory, so comes with a different binding.

compatible: "tinyvision,soc-controller"

include: base.yaml

properties:
  reg:
    required: true
```

## zephyr/dts/bindings/usb/zephyr,uvc-device.yaml
```yaml
# Copyright (c) 2024-2025 tinyVision.ai Inc.
# SPDX-License-Identifier: Apache-2.0

description: |
  USB Video Class instance

  The Video Class will present a standard Zephyr video endpoint to which video buffers can be sent.
  These video buffers will be transmitted to the host over the UVC protocol.
  The USB descriptors communicating the capabilities of this UVC instance will be generated from
  the video device configured using uvc_set_video_dev().

compatible: "zephyr,uvc-device"

include: base.yaml

on-bus: usb

properties:
  interface-name:
    type: string
```

## zephyr/dts/bindings/video/lattice,csi2rx.yaml
```yaml
# Copyright (c) 2025 tinyVision.ai Inc.
# SPDX-License-Identifier: Apache-2.0

description: MIPI CSI-2 D-PHY Receiver FPGA soft-core distributed by Lattice

compatible: "lattice,csi2rx"

include: base.yaml

child-binding:
  child-binding:
    include: video-interfaces.yaml
    properties:
      reg:
        type: array
        required: true
```

## zephyr/dts/bindings/video/tinyvision,debayer.yaml
```yaml
# Copyright (c) 2024 tinyVision.ai Inc.
# SPDX-License-Identifier: Apache-2.0

description: Debayer core present tinyVision.ai FPGA systems

compatible: "tinyvision,debayer"

include: base.yaml

child-binding:
  child-binding:
    include: video-interfaces.yaml
    properties:
      reg:
        type: array
        required: true
```

## zephyr/dts/bindings/video/tinyvision,stacker.yaml
```yaml
# Copyright (c) 2024 tinyVision.ai Inc.
# SPDX-License-Identifier: Apache-2.0

description: |
  Frame stacker core present tinyVision.ai FPGA systems

  This is a driver for the frame stacker engine that vertically aggregates frames from two image
  sensors.

compatible: "tinyvision,stacker"

include: base.yaml

properties:
  start-delay-us:
    type: int
    required: true
    description: Time in microseconds spent before the start of the first and second image sensor.

child-binding:
  child-binding:
    include: video-interfaces.yaml
    properties:
      reg:
        type: array
        required: true
```

## zephyr/dts/bindings/video/tinyvision,stats.yaml
```yaml
# Copyright (c) 2025 tinyVision.ai Inc.
# SPDX-License-Identifier: Apache-2.0

description: Debayer core present tinyVision.ai FPGA systems

compatible: "tinyvision,stats"

include: base.yaml

child-binding:
  child-binding:
    include: video-interfaces.yaml
```
