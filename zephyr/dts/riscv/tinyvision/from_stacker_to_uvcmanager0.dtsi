/*
 * Copyright (c) 2025 tinyVision.ai Inc.
 *
 * SPDX-License-Identifier: Apache-2.0
 */

&stacker { status = "okay"; };
&uvcmanager0 { status = "okay"; };

&stacker_ep_out {
	remote-endpoint-label = "uvcmanager0_ep_in";
};

&uvcmanager0_ep_in {
	remote-endpoint-label = "stacker_ep_out";
};
