/*
 * Copyright (c) 2025 tinyVision.ai Inc.
 *
 * SPDX-License-Identifier: Apache-2.0
 */

&unpacker0 { status = "okay"; };
&stacker { status = "okay"; };

&unpacker0_ep_out {
	remote-endpoint-label = "stacker_ep_in0";
};

&stacker_ep_in0 {
	remote-endpoint-label = "unpacker0_ep_out";
};
