/*
 * Copyright (c) 2025 tinyVision.ai Inc.
 *
 * SPDX-License-Identifier: Apache-2.0
 */

&stacker { status = "okay"; };
&debayer0 { status = "okay"; };

&stacker_ep_out {
	remote-endpoint-label = "debayer0_ep_in";
};

&debayer0_ep_in {
	remote-endpoint-label = "stacker_ep_out";
};
