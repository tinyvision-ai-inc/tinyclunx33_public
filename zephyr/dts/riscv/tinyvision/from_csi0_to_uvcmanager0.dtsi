/*
 * Copyright (c) 2025 tinyVision.ai Inc.
 *
 * SPDX-License-Identifier: Apache-2.0
 */

&csi0 { status = "okay"; };
&uvcmanager0 { status = "okay"; };

&csi0_ep_out2 {
	remote-endpoint-label = "uvcmanager0_ep_in";
};

&uvcmanager0_ep_in {
	remote-endpoint-label = "csi0_ep_out2";
};
