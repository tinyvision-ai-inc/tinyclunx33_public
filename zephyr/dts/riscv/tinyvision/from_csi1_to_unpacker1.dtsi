/*
 * Copyright (c) 2025 tinyVision.ai Inc.
 *
 * SPDX-License-Identifier: Apache-2.0
 */

&csi1 { status = "okay"; };
&unpacker1 { status = "okay"; };

&csi1_ep_out1 {
	remote-endpoint-label = "unpacker1_ep_in";
};

&unpacker1_ep_in {
	remote-endpoint-label = "csi1_ep_out1";
};
