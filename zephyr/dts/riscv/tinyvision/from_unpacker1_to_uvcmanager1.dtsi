/*
 * Copyright (c) 2025 tinyVision.ai Inc.
 *
 * SPDX-License-Identifier: Apache-2.0
 */

&unpacker1 { status = "okay"; };
&uvcmanager1 { status = "okay"; };

&unpacker1_ep_out {
	remote-endpoint-label = "uvcmanager1_ep_in";
};

&uvcmanager1_ep_in {
	remote-endpoint-label = "unpacker1_ep_out";
};
