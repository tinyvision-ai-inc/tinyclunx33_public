/*
 * Copyright (c) 2025 tinyVision.ai Inc.
 *
 * SPDX-License-Identifier: Apache-2.0
 */

&debayer0 { status = "okay"; };
&uvcmanager0 { status = "okay"; };

&uvcmanager0_ep_in {
	remote-endpoint-label = "debayer0_ep_out";
};

&debayer0_ep_out {
	remote-endpoint-label = "uvcmanager0_ep_in";
};
