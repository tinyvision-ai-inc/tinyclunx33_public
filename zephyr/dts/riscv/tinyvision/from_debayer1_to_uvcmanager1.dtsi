/*
 * Copyright (c) 2025 tinyVision.ai Inc.
 *
 * SPDX-License-Identifier: Apache-2.0
 */

&debayer1 { status = "okay"; };
&uvcmanager1 { status = "okay"; };

&uvcmanager1_ep_in {
	remote-endpoint-label = "debayer1_ep_out";
};

&debayer1_ep_out {
	remote-endpoint-label = "uvcmanager1_ep_in";
};
