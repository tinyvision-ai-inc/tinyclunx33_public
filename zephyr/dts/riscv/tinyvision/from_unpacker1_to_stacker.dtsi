/*
 * Copyright (c) 2025 tinyVision.ai Inc.
 *
 * SPDX-License-Identifier: Apache-2.0
 */

&unpacker1 { status = "okay"; };
&stacker { status = "okay"; };

&unpacker1_ep_out {
	remote-endpoint-label = "stacker_ep_in1";
};

&stacker_ep_in1 {
	remote-endpoint-label = "unpacker1_ep_out";
};
