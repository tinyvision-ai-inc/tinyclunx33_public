/*
 * Copyright (c) 2025 tinyVision.ai Inc.
 *
 * SPDX-License-Identifier: Apache-2.0
 */

&csi0 { status = "okay"; };
&unpacker0 { status = "okay"; };

&csi0_ep_out1 {
	remote-endpoint-label = "unpacker0_ep_in";
};

&unpacker0_ep_in {
	remote-endpoint-label = "csi0_ep_out1";
};
