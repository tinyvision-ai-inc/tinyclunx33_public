## zephyr/dts/bindings/video/tinyvision,testpattern.yaml
```yaml
# Copyright (c) 2024 tinyVision.ai Inc.
# SPDX-License-Identifier: Apache-2.0

description: Test pattern generator present on tinyVision.ai FPGA systems

compatible: "tinyvision,testpattern"

include: base.yaml

child-binding:
  child-binding:
    include: video-interfaces.yaml
```

## zephyr/dts/bindings/video/tinyvision,unpacker.yaml
```yaml
# Copyright (c) 2025 tinyVision.ai Inc.
# SPDX-License-Identifier: Apache-2.0

description: |
  Pixel format unpacker converting from MIPI data packed types such as Y10P, Y12P, Y14P to 16-bit
  unpacked data types, zero-padded.

compatible: "tinyvision,unpacker"

include: base.yaml

child-binding:
  child-binding:
    include: video-interfaces.yaml
    properties:
      reg:
        type: array
        required: true
```

## zephyr/dts/bindings/video/tinyvision,uvcmanager.yaml
```yaml
# Copyright (c) 2024 tinyVision.ai Inc.
# SPDX-License-Identifier: Apache-2.0

description: UVC accelerated endpoint transfer manager for the DWC3 core

compatible: "tinyvision,uvcmanager"

include: base.yaml

properties:
  reg:
    required: true

  usb-controller:
    type: phandle
    required: true

  usb-endpoint:
    type: int
    required: true

child-binding:
  child-binding:
    include: video-interfaces.yaml
```

## zephyr/soc/tinyvision/tinyclunx33/Kconfig.soc
```kconfig
# Copyright (c) 2024 tinyVision.ai Inc.
# SPDX-License-Identifier: Apache-2.0

config SOC_SERIES_TINYCLUNX33
	bool "tinyCLUNX33 RTL-basd SoC"
	help
	  Each SoC under this series is a release of an FPGA RTL ("gateware")
	  that implements the virtual SoC loaded onto the FPGA. They are
	  published by tinyVision.ai.

config SOC_TINYCLUNX33_RTL_0_8
	bool "tinyCLUNX33 RTL v0.8 release"
	select SOC_SERIES_TINYCLUNX33
	help
	  This SoC lacks MIPI support, but features a test pattern generator
	  to test the USB bandwidth.

config SOC_TINYCLUNX33_RTL_0_9
	bool "tinyCLUNX33 RTL v0.9 release"
	select SOC_SERIES_TINYCLUNX33
	help
	  This SoC introduces MIPI support.

config SOC_TINYCLUNX33_RTL_0_10
	bool "tinyCLUNX33 RTL v0.10 release"
	select SOC_SERIES_TINYCLUNX33
	help
	  The tinyCLUNX33 RTL v0.10 release.

config SOC_TINYCLUNX33_RTL_0_11
	bool "tinyCLUNX33 RTL v0.11 release"
	select SOC_SERIES_TINYCLUNX33
	help
	  The tinyCLUNX33 RTL v0.11 release.

config SOC_TINYCLUNX33_RTL_1_0
	bool "tinyCLUNX33 RTL v1.0.* releases"
	select SOC_SERIES_TINYCLUNX33
	help
	  The tinyCLUNX33 RTL v1.0.* releases.

config SOC_TINYCLUNX33_RTL_1_1
	bool "tinyCLUNX33 RTL v1.1.* releases"
	select SOC_SERIES_TINYCLUNX33
	help
	  The tinyCLUNX33 RTL v1.1.* releases.

config SOC_SERIES
	default "tinyclunx33" if SOC_SERIES_TINYCLUNX33

config SOC
	default "rtl_0_8" if SOC_TINYCLUNX33_RTL_0_8
	default "rtl_0_9" if SOC_TINYCLUNX33_RTL_0_9
	default "rtl_0_10" if SOC_TINYCLUNX33_RTL_0_10
	default "rtl_0_11" if SOC_TINYCLUNX33_RTL_0_11
	default "rtl_1_0" if SOC_TINYCLUNX33_RTL_1_0
	default "rtl_1_1" if SOC_TINYCLUNX33_RTL_1_1
```

## zephyr/subsys/Kconfig
```kconfig
# Copyright (c) 2024 tinyVision.ai Inc.
# SPDX-License-Identifier: Apache-2.0

rsource "usb/device_next/Kconfig"
```

## zephyr/subsys/usb/device_next/Kconfig
```kconfig
# Copyright (c) 2024 tinyVision.ai Inc.
# SPDX-License-Identifier: Apache-2.0

if USB_DEVICE_STACK_NEXT

rsource "class/Kconfig.cdc_raw"

endif # USB_DEVICE_STACK_NEXT
```
